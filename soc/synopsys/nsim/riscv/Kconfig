## soc/synopsys/nsim/riscv/Kconfig
```kconfig
# Copyright (c) 2018 Synopsys, Inc. All rights reserved.
# SPDX-License-Identifier: Apache-2.0

config SOC_NSIM_RV
	bool "Synopsys RMX5X implementation"
	select SOC_FAMILY_SNPS_AV5RMX
	select RISCV
	select RISCV_PRIVILEGED
	select RISCV_HAS_PLIC
#	select RISCV_HAS_CLIC
	select RISCV_ISA_RV32I
	select RISCV_ISA_EXT_G
#	G by-default includes the following:
#			RISCV_ISA_EXT_M
#			RISCV_ISA_EXT_A
#			RISCV_ISA_EXT_F
#			RISCV_ISA_EXT_D
#			RISCV_ISA_EXT_ZICSR
#			RISCV_ISA_EXT_ZIFENCEI
	select RISCV_ISA_EXT_C
#	select RISCV_ISA_EXT_V # V is not supported by zephyr
	select ATOMIC_OPERATIONS_BUILTIN
	select INCLUDE_RESET_VECTOR
	
# Strange compilers behavior: 
# -- zephyr compiler does not work correct without
# CONFIG_RISCV_SOC_HAS_CUSTOM_IRQ_LOCK_OPS macro (should be no-inlined???).
# -- cross-compile works fine with CONFIG_RISCV_SOC_HAS_CUSTOM_IRQ_LOCK_OPS=n
# --llvm does not work correct at all (some irq issue)
	select RISCV_SOC_HAS_CUSTOM_IRQ_LOCK_OPS
```

## soc/synopsys/nsim/riscv/Kconfig.soc
```kconfig
# Copyright (c) 2018 Synopsys, Inc. All rights reserved.
# SPDX-License-Identifier: Apache-2.0

config SOC_NSIM_RV
	bool

config SOC_NSIM_RMX500
	bool
	select SOC_NSIM_RV
	help
	  Synopsys RISCV Rmx500 in nSIM

config SOC
	default "nsim_rmx500" if SOC_NSIM_RMX500

config SOC_SERIES
	default "nsim_rmx" if SOC_NSIM_RV
```
