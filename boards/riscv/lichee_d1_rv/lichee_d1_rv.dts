/dts-v1/;

#include <aw_d1/d1_rv.dtsi>

/ {
	model = "Sipeed Lichee D1 RV";
	compatible = "sipeed,lichee_d1_rv";

	aliases {
		uart-0 = &uart0;
	};

	chosen {
		zephyr,sram = &ddr0;
		zephyr,console = &uart0;
		zephyr,shell-uart = &uart0;
	};

};

&uart0 {
	status = "okay";
	current-speed = <115200>;
};
