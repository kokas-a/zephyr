/*
 * Copyright (c) 2017, embedjournal.com
 *
 * SPDX-License-Identifier: Apache-2.0
 */

/dts-v1/;
#include "stm32f303_min.dtsi"

/ {
	model = "STM32 Minimum Development Board (303)";
	compatible = "stm32f303_min", "st,stm32f303cc";

	leds {
		led: led {
			gpios = <&gpioc 13 GPIO_ACTIVE_LOW>;
		};
	};
};
