## boards/arm/bb_min/Kconfig.board
```kconfig
config BOARD_BB_MIN
	bool "BeagleBone-based Miner control board"
	depends on SOC_TI_AM33XX
	help
	  Reduced version of BeagleBone Black board. Reduced to 600MHz Freq.
	  With no USB, no video, no eMMC, but with NAND.
```

## boards/arm/bb_min/bb_min_defconfig
```kconfig
CONFIG_SOC_TI_AM33XX=y
CONFIG_BOARD_BB_MIN=y
CONFIG_SYS_CLOCK_TICKS_PER_SEC=100
CONFIG_BUILD_NO_GAP_FILL=y
#CONFIG_BUILD_OUTPUT_BIN=n
CONFIG_BUILD_OUTPUT_HEX=y
CONFIG_CONSOLE=y
CONFIG_UART_CONSOLE=y
CONFIG_SERIAL=y
CONFIG_MP_MAX_NUM_CPUS=1
CONFIG_FLASH_SIZE=0
CONFIG_FLASH_BASE_ADDRESS=0x0
CONFIG_DEBUG_OPTIMIZATIONS=y

CONFIG_ARM_AARCH32_MMU=n
```

## boards/arm/stm32f303_min/Kconfig.board
```kconfig
# STM32 Minimum Development Board Configuration

# Copyright (c) 2017, embedjournal.com
# SPDX-License-Identifier: Apache-2.0

config BOARD_STM32F303_MIN
	bool "STM32 Minimum Development Board (303)"
	depends on SOC_STM32F303XC
```

## boards/arm/stm32f303_min/Kconfig.defconfig
```kconfig
# STM32 Minimum Development Board Configuration

# Copyright (c) 2017, embedjournal.com
# SPDX-License-Identifier: Apache-2.0

if BOARD_STM32F303_MIN

config BOARD
	default "stm32f303_min" if BOARD_STM32F303_MIN

endif # BOARD_STM32F303_MIN
```

## boards/riscv/lichee_d1_rv/Kconfig.board
```kconfig
config BOARD_LICHEE_D1_RV
	bool "Lichee D1 RV"
	select 64BIT
#	select SCHED_IPI_SUPPORTED
#	select CPU_HAS_FPU_DOUBLE_PRECISION
```

## boards/riscv/lichee_d1_rv/Kconfig.defconfig
```kconfig
if BOARD_LICHEE_D1_RV

config BOARD
	default "lichee_d1_rv"

config SYS_CLOCK_TICKS_PER_SEC
	default 1000

endif #BOARD_LICHEE_D1_RV
```

## boards/riscv/snps_rmx500/Kconfig.defconfig
```kconfig
if BOARD_SNPS_RMX500

config BOARD
	default "snps_rmx500"

config SYS_CLOCK_TICKS_PER_SEC
	default 1000

endif #BOARD_SNPS_RMX500
```

## boards/synopsys/nsim/riscv/Kconfig.defconfig
```kconfig
if BOARD_NSIM_RMX500

config BOARD
	default "nsim_rmx500"

config SYS_CLOCK_TICKS_PER_SEC
	default 1000

endif #BOARD_NSIM_RMX500
```

## boards/synopsys/nsim/riscv/nsim_rmx500_defconfig
```kconfig
CONFIG_BOARD_NSIM_RMX500=y
#CONFIG_SOC_SERIES_RMX5X=y
#CONFIG_SOC_RMX5X=y
CONFIG_XIP=n
CONFIG_CONSOLE=y
CONFIG_SERIAL=y
CONFIG_UART_CONSOLE=y
CONFIG_BUILD_OUTPUT_HEX=y
CONFIG_MP_MAX_NUM_CPUS=1
CONFIG_FLASH_SIZE=0
CONFIG_FLASH_BASE_ADDRESS=0x0
CONFIG_DEBUG_OPTIMIZATIONS=y
# CONFIG_PLATFORM_SPECIFIC_INIT=y
CONFIG_INCLUDE_RESET_VECTOR=y
CONFIG_LOG=y

# Strange compilers behavior: 
# -- zephyr compiler does not work correct without
# CONFIG_RISCV_SOC_HAS_CUSTOM_IRQ_LOCK_OPS macro (should be no-inlined???).
# -- cross-compile works fine with CONFIG_RISCV_SOC_HAS_CUSTOM_IRQ_LOCK_OPS=n
# --llvm does not work correct at all (some irq issue)
CONFIG_RISCV_SOC_HAS_CUSTOM_IRQ_LOCK_OPS=y
```

## cmake/toolchain/llvm/Kconfig
```kconfig
# Copyright (c) 2023 Intel Corporation
# SPDX-License-Identifier: Apache-2.0

choice LLVM_LINKER
	prompt "LLVM Linker"
	depends on "${ZEPHYR_TOOLCHAIN_VARIANT}" = "llvm"
#FIXME: set default LLVM_USE_LLD for CONFIG_BOARD_SNPS_RMX500(rv32)
	default LLVM_USE_LLD

config LLVM_USE_LD
	bool "GNU ld"
	help
	  Use binutils ld linker with llvm/clang.

config LLVM_USE_LLD
	bool "LLVM lld"
	help
	  Use LLVM built-in lld linker with llvm/clang.

endchoice
```

## dts/bindings/interrupt-controller/ti,am33xx-intc.yaml
```yaml
description: TI AM33xx interrupt controller

compatible: "ti,am33xx-intc"

include: [interrupt-controller.yaml, base.yaml]

properties:
  "#interrupt-cells":
    const: 2

interrupt-cells:
  - irq
  - priority
```

## dts/bindings/riscv/thead,c906.yaml
```yaml
description: alwinner d1 core

compatible: "thead,c906"

include: riscv,cpus.yaml

properties:
  d-cache-block-size:
    type: int
    required: true
    description: Data Cache block size

  d-cache-sets:
    type: int
    required: true
    description: Data Cache sets

  d-cache-size:
    type: int
    required: true
    description: Data Cache size

  i-cache-block-size:
    type: int
    required: true
    description: Instruction Cache block size

  i-cache-sets:
    type: int
    required: true
    description: Instruction Cache sets

  i-cache-size:
    type: int
    required: true
    description: Instruction Cache size
```

## dts/bindings/timer/snps,clint0.yaml
```yaml
# Copyright (c) 2024 Synopsys
# SPDX-License-Identifier: Apache-2.0

description: Synopsys ARC-V Core-Local Interruptor.

compatible: "snps,clint0"

include: base.yaml

properties:
  reg:
    required: true
```

## dts/bindings/timer/thead,c900-clint.yaml
```yaml
description: THead C900 RISC-V Core-Local Interruptor.

compatible: "thead,c900-clint"

include: sifive,clint0.yaml
```

## soc/arm/ti_am33xx/Kconfig.defconfig
```kconfig
if SOC_TI_AM33XX

config SOC
	default "ti_am33xx"

config ARM_CUSTOM_INTERRUPT_CONTROLLER
	default y

config AM33XX_INTC
	bool "ti am33xx interrupt controller"
	default y

config AM33XX_TIMER
	bool "ti am33xx timer"
	default y

config NUM_IRQS
	default 125

config SYS_CLOCK_HW_CYCLES_PER_SEC
#	default 600000000
	default 32768

config UART_NS16550_ACCESS_WORD_ONLY
	default y
	depends on UART_NS16550

endif # SOC_TI_AM33XX
```

## soc/riscv/aw_d1/Kconfig.defconfig
```kconfig
if SOC_AW_D1

config SOC
	default "aw_d1"


#FIXME:
config SYS_CLOCK_HW_CYCLES_PER_SEC
	default 24000000

config RISCV_SOC_INTERRUPT_INIT
	default y	

config UART_NS16550_ACCESS_WORD_ONLY
	default y
	depends on UART_NS16550
	
config NUM_IRQS
	default 223
	
config RISCV_GP
	default y	

endif #SOC_AW_D1
```

## soc/riscv/aw_d1/Kconfig.soc
```kconfig
config SOC_AW_D1
	bool "AllWinner D1 SoC"
	select RISCV
	select RISCV_PRIVILEGED
	select RISCV_HAS_PLIC
#	select RISCV_HAS_CLIC
	select RISCV_ISA_RV64I
	select RISCV_ISA_EXT_G
#	G by-default includes the following:
#			RISCV_ISA_EXT_M
#			RISCV_ISA_EXT_A
#			RISCV_ISA_EXT_F
#			RISCV_ISA_EXT_D
#			RISCV_ISA_EXT_ZICSR
#			RISCV_ISA_EXT_ZIFENCEI
	select RISCV_ISA_EXT_C
#	select RISCV_ISA_EXT_V # V is not supported by zephyr
	select ATOMIC_OPERATIONS_BUILTIN
```

## soc/riscv/snps_av5rmx/Kconfig
```kconfig
# Copyright (c) 2024 Synopsys
# SPDX-License-Identifier: Apache-2.0

config SOC_FAMILY_SNPS_AV5RMX
	bool

if SOC_FAMILY_SNPS_AV5RMX

config SOC_FAMILY
	string
	default "snps_av5rmx"

source "soc/riscv/snps_av5rmx/*/Kconfig.soc"

endif # SOC_FAMILY_SNPS_AV5RMX
```

## soc/riscv/snps_av5rmx/Kconfig.defconfig
```kconfig
# Copyright (c) 2024 Synopsys
# SPDX-License-Identifier: Apache-2.0

source "soc/riscv/snps_av5rmx/*/Kconfig.defconfig.series"
```

## soc/riscv/snps_av5rmx/rmx5x/Kconfig.defconfig.series
```kconfig
# Copyright (c) 2024 Synopsys
# SPDX-License-Identifier: Apache-2.0

if SOC_SERIES_RMX5X

config SOC_SERIES
	default "rmx5x"
	
config SYS_CLOCK_HW_CYCLES_PER_SEC
	default 24000000

config RISCV_SOC_INTERRUPT_INIT
	default y	

config UART_NS16550_ACCESS_WORD_ONLY
	default y
	depends on UART_NS16550

config NUM_IRQS
	default 223

config RISCV_GP
	default y	

endif # SOC_SERIES_RMX5X
```
